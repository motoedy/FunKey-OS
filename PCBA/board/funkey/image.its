## PCBA/board/funkey/image.its
```
/dts-v1/;

/ {
	description = "FunKey-OS FIT image";
	#address-cells = <1>;

	images {
		kernel@1 {
			description = "kernel";
			data = /incbin/("./zImage");
			type = "kernel";
			arch = "arm";
			os = "linux";
			compression = "none";
			load = <0x41000000>;
			entry = <0x41000000>;
			hash@1 {
				algo = "sha1";
			};
		};

		ramdisk@1 {
			description = "rootfs";
			data = /incbin/("./rootfs.cpio.lzma");
			type = "ramdisk";
			arch = "arm";
			os = "linux";
			compression = "none";
			load = <0x41b00000>;
			entry = <0x41b00000>;
			hash@1 {
				algo = "sha1";
			};
		};

		fdt@1 {
			description = "device tree";
			data = /incbin/("./sun8i-v3s-funkey.dtb");
			type = "flat_dt";
			arch = "arm";
			load = <0x41800000>;
			entry = <0x41800000>;
			compression = "none";
			hash@1 {
				algo = "sha1";
			};
		};
		script@1 {
			description = "Bootscript";
			data = /incbin/("./boot.cmd");
			type = "script";
			load = <0x41900000>;
			compression = "none";
			hash@1 {
				algo = "sha1";
			};
		};
	};

	configurations {
		default = "config@1";

		config@1 {
			description = "default configuration";
			kernel = "kernel@1";
			ramdisk = "ramdisk@1";
			fdt = "fdt@1";
			script = "script@1";
		};
	};
};
```
